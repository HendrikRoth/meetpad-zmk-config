## boards/shields/meetpad/Kconfig.defconfig
```kconfig
# Copyright (c) 2021 The ZMK Contributors
# SPDX-License-Identifier: MIT

if SHIELD_MEETPAD

config ZMK_KEYBOARD_NAME
    default "Meetpad"

endif
```

## boards/shields/meetpad/Kconfig.shield
```kconfig
# Copyright (c) 2021 The ZMK Contributors
# SPDX-License-Identifier: MIT

config SHIELD_MEETPAD
    def_bool $(shields_list_contains,meetpad)
```
